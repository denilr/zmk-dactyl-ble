## boards/shields/dactyl/Kconfig.defconfig
```kconfig
if SHIELD_DACTYL_LEFT
	config ZMK_SPLIT_ROLE_CENTRAL
		default y

	config ZMK_SPLIT
		default y
		
	config ZMK_SPLIT_BLE_ROLE_CENTRAL
		default y
endif

if SHIELD_DACTYL_RIGHT
	config ZMK_SPLIT
		default y
endif
```
